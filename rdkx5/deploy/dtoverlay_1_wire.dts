/dts-v1/;
/plugin/;

/*
 * RDK X5 双路独立 1-Wire 总线（DS18B20 两只探头单独走线，互不并联）
 *
 *   onewire-0: 40-pin 37 脚, lsio 线22 (lsio_gpio0_22, SOC401), -> w1_bus_master1 -> ds18b20_1（探头1）
 *   onewire-1: 40-pin 15 脚, lsio 线9  (lsio_gpio0_9,  SOC388), -> w1_bus_master2 -> ds18b20_2（探头2）
 *
 * 2026-09-29 脚位重绑（docs/PINMAP.md §4 三源考证：官方 40pin 全表 + 出厂库
 * RDK_X5_PIN + 板卡 gpioinfo/pinmux-pins 一手输出）：
 *   - 37脚 = SOC401 = lsio 线22（出厂表行 (401,37,26,'GPIO26','SPI2_MISO')）；
 *   - 15脚 = SOC388 = lsio 线9（出厂表行 (388,15,22,'GPIO22','UART2_TXD')）；
 *   - lsio 线26 = SOC405，官方全表与出厂 RDK_X5_PIN 均无此垫——**不在 40-pin 排针上**。
 * 2026-09-21 版注释曾称"线26（37脚）读到稳定高电平（探头1+上拉在线）"：按三源映射，
 * 线26 根本不通排针，该读数更可能是悬空垫被内部弱上拉读高——与 CONTEXT_BASELINE.md
 * "DS18B20 供电+上拉未完成"亦互相矛盾。矛盾如实记录存疑，不作为绑定依据（铁律③）。
 *
 * 注意：11 脚/13 脚是 UART7 的 TXD/RXD 复用脚，已留给前视超声波，不得占用。
 * 两节点均为 w1-gpio + open-drain，DS18B20 模块需自带 4.7k 上拉。
 * 若 dtc 报 pinctrl 标签未定义，用下面命令核对板上真实标签名后替换：
 *   dtc -I dtb -O dts /boot/hobot*.dtb 2>/dev/null | grep -o "lsio_gpio0_[0-9]*" | sort -u
 */
/ {
	fragment@0 {
		target-path = "/";
		__overlay__ {
			onewire-0 {
				compatible = "w1-gpio";
				pinctrl-names = "default";
				pinctrl-0 = <&lsio_gpio0_22>;
				gpios = <&ls_gpio0_porta 22 1>;
				linux,open-drain;
				status = "okay";
			};
		};
	};

	fragment@1 {
		target-path = "/";
		__overlay__ {
			onewire-1 {
				compatible = "w1-gpio";
				pinctrl-names = "default";
				pinctrl-0 = <&lsio_gpio0_9>;
				gpios = <&ls_gpio0_porta 9 1>;
				linux,open-drain;
				status = "okay";
			};
		};
	};
};
